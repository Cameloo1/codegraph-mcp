## fixtures/buildroot_text_evidence_mini/package/foo/Config.in
```kconfig
config BR2_PACKAGE_FOO
	bool "foo"
	depends on BR2_USE_MMU
	select BR2_PACKAGE_BAR
	help
	  The foo package exercises Buildroot text evidence for Config.in.
```

## fixtures/nuance_rescue_matrix/package/foo/Config.in
```kconfig
config BR2_PACKAGE_FOO
	bool "foo nuance rescue fixture"
	select BR2_PACKAGE_HAS_NUANCE_RESCUE
	help
	  The foo package is a deterministic Buildroot config fixture for
	  BR2_PACKAGE_FOO and 1-bit nuance-rescue candidate recall.
```
